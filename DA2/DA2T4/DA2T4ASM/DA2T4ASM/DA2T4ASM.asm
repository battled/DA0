;
; DA2new.asm
; task 4 (task 3 w/ interrupts)
; Created: 3/9/2016 10:21:51 AM
; Author : desi.battle
;

.ORG 0x0000		;RESET LOCATION
JMP MAIN

.ORG 0X0008	;PCINT1 ADDR NOTE ONCE INTERRUPT HANDLER STARTED THE OFFENDING INTERRUPT FLAG AND I BIT IN STATUS REG ARE DISABLED
	JMP PCINTX	
PCINTX:
SBIS PORTC, 0
RJMP NOCOUNT
INC R21		;use r21 to track high pulses
CPI R21, 5
BREQ DOFIVE	;if r21 == 5 flip portc4
CPI R21, 10
BREQ DOTEN	;if r21 == 10 flip portc4,5 and set r21 ==0
RJMP DONEFLIP
DOFIVE:
LDI R19, 0X10
RJMP STOREFLIP

DOTEN:
LDI R19, 0X30
LDI R21, 0
STOREFLIP:

EOR R17, R19
OUT PORTC, R17

DONEFLIP:
INC R18
OUT PORTB, R18

NOCOUNT:
RETI	;RETI RETURNS TO CODE BEING EXECUTED WHEN INTERRUPT OCCURS AND SETS I BIT TO ONE IN SREG

.MACRO INITSTACK
LDI R16, HIGH(RAMEND)
OUT SPH,R16
LDI R16,LOW(RAMEND)
OUT SPL,R16
.ENDMACRO




MAIN:
INITSTACK ;use Macro here

LDI R22, 1<< PCINT8	
STS PCMSK1, R22 ;SET PCINT8 BIT TO ONE TO ENABLE PC0 TO TRIGGER INTERRUPTS
LDI R22, 1<< PCIE1
STS PCICR, R22	;ENABLE PINCHANGE1 INTERRUPT
SEI				;SET I FLAG ENABLING GLOBAL INTERRUPTS

;Make entire port B output.
LDI R16, 0XFF
OUT DDRB, R16
LDI R16, 0X31
OUT DDRC, R16; MAKE PC5,PC4,PC0 OUTPUTS
;set 0th bit in r16 to 1 for EOR with PC0 
LDI R16,0b00000001			;eor reg for PC0
LDI R17,0x80				;portc temp holder
LDI R18,0	;R18 IS COUNTER
OUT PORTC,R17 ;PC = 0
LDI R21, 0					;5COUNT

BEGIN:
RCALL DELAY
EOR R17,R16 ;toggle Bit0 of R17;
OUT PORTC,R17 ;toggle PC0
RJMP BEGIN
;TIMER1 DELAY


DELAY:
LDI R20,HIGH(34286)
STS TCNT1H,R20 ;TCNT1H = high portion of 34285
LDI R20,LOW(34286)
STS TCNT1L,R20 ;TCNT1L = low portion of 34285
LDI R20,0x00
STS TCCR1A,R20 ;WGM11:10 = 00 Normal mode
LDI R20,0x03
STS TCCR1B,R20 ;WGM13:12 = 00, Normal mode, prescaler = 3 (1/64)

AGAIN:
IN R20,TIFR1 ;read TIFR
SBRS R20,TOV1 ;if TOV1 is set skip next instruction
RJMP AGAIN

LDI R20,0x00
STS TCCR1B,R20 ;stop Timer1
LDI R20,0x01
OUT TIFR1,R20 ;clear TOV1 flag
RET